/*
╭─────┬─────┬─────┬─────┬─────┬─────┬─────┬─────┬─────┬─────╮
  LT0   LT1   LT2   LT3   LT4   RT4   RT3   RT2   RT1   RT0
├─────┼─────┼─────┼─────┼─────┼─────┼─────┼─────┼─────┼─────┤
  LM0   LM1   LM2   LM3   LM4   RM4   RM3   RM2   RM1   RM0
╰─────┼─────┼─────┼─────┼─────┴─────┼─────┼─────┼─────┼─────╯
        LB1   LB2   LB3               RB3   RB2   RB1
      ╰─────┴─────┼─────┼─────┬─────┼─────┼─────┴─────╯
                    LH1   LH0   RH0   RH1
                  ╰─────┴─────┴─────┴─────╯
*/
#include <behaviors.dtsi>
#include <dt-bindings/zmk/keys.h>
#include <dt-bindings/zmk/bt.h>
#include <dt-bindings/zmk/outputs.h>
#include <dt-bindings/zmk/pointing.h>

#include "zmk-helpers/helper.h"
#include "zmk-helpers/key-labels/zilpzalp.h"

#define TOP_START_PADDING
#define TOP_END_PADDING
#define MIDDLE_START_PADDING
#define MIDDLE_END_PADDING
#define BOTTOM_START_PADDING
#define BOTTOM_MIDDLE_PADDING
#define BOTTOM_END_PADDING
#define THUMB_START_PADDING
#define THUMB_END_PADDING

#define LT4
#define RT4

#include "common.h"
#include "combo.h"
#include "layers/a.h"
#include "layers/b.h"
#include "layers/c.h"
#include "layers/d.h"
#include "layers/e.h"
#include "layers/f.h"
#include "layers/g.h"
