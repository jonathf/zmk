## config/west.yml
```yaml
manifest:
  remotes:
    - name: zmkfirmware
      url-base: https://github.com/zmkfirmware
    # - name: rschenk
    #   url-base: https://github.com/rschenk
    - name: urob
      url-base: https://github.com/urob
    - name: kilipan
      url-base: https://github.com/kilipan
  projects:
    - name: zmk
      remote: zmkfirmware
      revision: v0.3.0
      import: app/west.yml
    # - name: zmk-keyboard-re-gret
    #   remote: rschenk
    #   revision: v0.3.0
    - name: zmk-helpers
      remote: urob
      revision: main
    - name: zmk-keyboards-zilpzalp
      remote: kilipan
      revision: main
  self:
    path: config
```
