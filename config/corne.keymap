/*
╭─────┬─────┬─────┬─────┬─────┬─────┬─────┬─────┬─────┬─────╮
   x    LT3   LT2   LT1   LT0   RT0   RT1   RT2   RT3   RT4
├─────┼─────┼─────┼─────┼─────┼─────┼─────┼─────┼─────┼─────┤
  LM4   LM3   LM2   LM1   LM0   RM0   RM1   RM2   RM3   RM4
╰─────┼─────┼─────┼─────┼─────┴─────┼─────┼─────┼─────┼─────╯
        LB3   LB2   LB1               RB1   RB2   RB3
      ╰─────┴─────┼─────┼─────┬─────┼─────┼─────┴─────╯
               x    LH1   LH0   RH0   RH1    x
                  ╰─────┴─────┴─────┴─────╯
*/
#include <behaviors.dtsi>
#include <dt-bindings/zmk/keys.h>
#include <dt-bindings/zmk/bt.h>
#include <dt-bindings/zmk/outputs.h>
#include <dt-bindings/zmk/pointing.h>

#include "zmk-helpers/helper.h"
#include "zmk-helpers/key-labels/42.h"

#define TOP_START_PADDING _ _
#define TOP_END_PADDING _ _
#define MIDDLE_START_PADDING _
#define MIDDLE_END_PADDING _
#define BOTTOM_START_PADDING _ _
#define BOTTOM_MIDDLE_PADDING _ _
#define BOTTOM_END_PADDING _ _
#define THUMB_START_PADDING _
#define THUMB_END_PADDING _

#include "common.h"
#include "combo.h"
#include "layers/a.h"
#include "layers/b.h"
#include "layers/c.h"
#include "layers/d.h"
#include "layers/e.h"
#include "layers/f.h"
#include "layers/g.h"
